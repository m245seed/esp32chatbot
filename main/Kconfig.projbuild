## main/Kconfig.projbuild
```kconfig
menu "Xiaozhi Assistant"

config OTA_URL
    string "Default OTA URL"
    default "https://api.tenclass.net/xiaozhi/ota/"
    help
        The application will access this URL to check for new firmwares and server address.

choice
    prompt "Default Language"
    default LANGUAGE_EN_US
    help
        Select device display language

    config LANGUAGE_EN_US
        bool "English"
endchoice

choice BOARD_TYPE
    prompt "Board Type"
    default BOARD_TYPE_ESP32C6_LCD_1_69
    help
        Board type. 开发板类型

    config BOARD_TYPE_ESP32C6_LCD_1_69
        bool "Waveshare ESP32C6 LCD 1.69\""
        depends on IDF_TARGET_ESP32C6
endchoice

config USE_WECHAT_MESSAGE_STYLE
    bool "Enable WeChat Message Style"
    default n
    help
        使用微信聊天界面风格

config USE_ESP_WAKE_WORD
    bool "Enable Wake Word Detection"
    default n
    depends on IDF_TARGET_ESP32C6
    help
        仅支持 ESP32 C6

config USE_ACOUSTIC_WIFI_PROVISIONING
    bool "Enable Acoustic WiFi Provisioning"
    default n
    help
        启用声波配网功能，使用音频信号传输 WiFi 配置数据

config RECEIVE_CUSTOM_MESSAGE
    bool "Enable Custom Message Reception"
    default n
    help
        启用接收自定义消息功能，允许设备接收来自服务器的自定义消息（最好通过 MQTT 协议）

endmenu
```

## sdkconfig.defaults.esp32
```kconfig
CONFIG_ESPTOOLPY_FLASHSIZE_16MB=y
CONFIG_PARTITION_TABLE_CUSTOM=y
CONFIG_PARTITION_TABLE_CUSTOM_FILENAME="partitions/v1/16m.csv"
CONFIG_PARTITION_TABLE_FILENAME="partitions/v1/16m.csv"
CONFIG_SR_WN_WN9_NIHAOXIAOZHI_TTS=y
CONFIG_ESP_TASK_WDT_TIMEOUT_S=20
```
